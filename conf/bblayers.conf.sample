## conf/bblayers.conf.sample
```bitbake
CONF_VERSION = "7"

BBPATH = "${TOPDIR}"
LAYERS_DIR = "{{layers}}"

BBFILES ?= ""
BBLAYERS = " \
  ${LAYERS_DIR}/poky/meta \
  ${LAYERS_DIR}/poky/meta-poky \
  \
  ${LAYERS_DIR}/meta-openembedded/meta-oe \
  ${LAYERS_DIR}/meta-openembedded/meta-filesystems \
  ${LAYERS_DIR}/meta-openembedded/meta-python \
  ${LAYERS_DIR}/meta-openembedded/meta-networking \
  ${LAYERS_DIR}/meta-openembedded/meta-multimedia \
  \
  ${LAYERS_DIR}/meta-{{machine-layer-suffix}} \
  \
  ${LAYERS_DIR}/meta-updater \
  ${LAYERS_DIR}/meta-updater-{{machine-layer-suffix}} \
  ${LAYERS_DIR}/meta-fotahub \
  ${LAYERS_DIR}/meta-fotahub-examples \
"
```

## conf/distro/fotahub-apps.conf
```bitbake
require conf/distro/poky.conf
require conf/distro/fotahub-base.conf

DISTRO = "fotahub-apps"
DISTRO_NAME = "FotaHub Applications"
DISTRO_VERSION = "1.0"
DISTRO_CODENAME = ""

PREFERRED_PROVIDER_virtual/base-utils = "toybox"
VIRTUAL-RUNTIME_base-utils = "toybox"

MACHINE_FEATURES = ""
BAD_RECOMMENDATIONS += "busybox-syslog busybox-udhcpc"

DISTRO_FEATURES_append = " libpng opengl usrmerge systemd"
```

## conf/distro/fotahub-base.conf
```bitbake
TMPDIR = "${TOPDIR}/tmp/${DISTRO}"

PACKAGE_CLASSES ?= "package_rpm"
USER_CLASSES ?= "buildstats image-mklibs"

PREFERRED_RPROVIDER_network-configuration ?= "connman"

HOSTTOOLS_append = " ostree ostree-push sshpass"

PATCHRESOLVE = "noop"
BB_DISKMON_DIRS ??= "\
    STOPTASKS,${TMPDIR},1G,100K \
    STOPTASKS,${DL_DIR},1G,100K \
    STOPTASKS,${SSTATE_DIR},1G,100K \
    STOPTASKS,/tmp,100M,100K \
    ABORT,${TMPDIR},100M,1K \
    ABORT,${DL_DIR},100M,1K \
    ABORT,${SSTATE_DIR},100M,1K \
    ABORT,/tmp,10M,1K \
"

PACKAGECONFIG_append_pn-qemu-native = " sdl"
PACKAGECONFIG_append_pn-nativesdk-qemu = " sdl"

SDK_VENDOR = "-fotahub"
SDK_VERSION := "${@'${DISTRO_VERSION}'.replace('snapshot-${DATE}','snapshot')}"

MAINTAINER = "FotaHub <contact@fotahub.com>"

TARGET_VENDOR = "-fotahub"

LOCALCONF_VERSION = "1"

DISTRO_VERSION[vardepsexclude] = "DATE"
SDK_VERSION[vardepsexclude] = "DATE"

DISTRO_FEATURES_remove = "x11"
DISTRO_FEATURES_remove = "${@bb.utils.contains_any('MACHINE', ['imx8mqevk'], '', 'wayland', d)}"

INHERIT += " fotahub_sota"
```

## conf/distro/fotahub-os.conf
```bitbake
require conf/distro/poky.conf
require conf/distro/fotahub-base.conf

DISTRO = "fotahub-os"
DISTRO_NAME = "FotaHub OS"
DISTRO_VERSION = "1.0"
DISTRO_CODENAME = ""

# Enable systemd support
# (see https://www.yoctoproject.org/docs/2.0/dev-manual/dev-manual.html#using-systemd-exclusively for details)
DISTRO_FEATURES_append = " systemd"
VIRTUAL-RUNTIME_init_manager = "systemd"
DISTRO_FEATURES_BACKFILL_CONSIDERED = "sysvinit"
VIRTUAL-RUNTIME_initscripts = ""

DISTRO_FEATURES_append = " virtualization sota"

PREFERRED_PROVIDER_virtual/runc = "runc-opencontainers"

# Prelinking increases the size of downloads and causes build errors
USER_CLASSES_remove = "image-prelink"

HOSTTOOLS_append = " sync sha256sum"

APPS_DIR = "apps"
DEPLOY_DIR_APPS = "${@d.getVar('DEPLOY_DIR_IMAGE').replace('fotahub-os', 'fotahub-apps')}"
```

## conf/layer.conf
```bitbake
# We have a conf and classes directory, add to BBPATH
BBPATH .= ":${LAYERDIR}"

# We have a recipes directory containing .bb and .bbappend files, add to BBFILES
BBFILES += "${LAYERDIR}/recipes-*/*/*.bb \
            ${LAYERDIR}/recipes-*/*/*.bbappend"

BBFILE_COLLECTIONS += "fotahub"
BBFILE_PATTERN_fotahub = "^${LAYERDIR}/"
BBFILE_PRIORITY_fotahub = "9"

LAYERDEPENDS_fotahub = "core"
LAYERSERIES_COMPAT_fotahub = "rocko"

# The dynamic-layers directory hosts the extensions and layer specific
# modifications.
#
# The .bbappend and .bb files are included if the respective layer
# collection is available.
BBFILES += "${@' '.join('${LAYERDIR}/dynamic-layers/%s/recipes*/*/*.bbappend' % layer \
               for layer in BBFILE_COLLECTIONS.split())}"
BBFILES += "${@' '.join('${LAYERDIR}/dynamic-layers/%s/recipes*/*/*.bb' % layer \
               for layer in BBFILE_COLLECTIONS.split())}"

BBFILES_DYNAMIC += " \
    raspberrypi:${LAYERDIR}/dynamic-layers/raspberrypi-layer/*/*/*.bb \
    raspberrypi:${LAYERDIR}/dynamic-layers/raspberrypi-layer/*/*/*.bbappend \
"

BBMASK += " \
    /meta-updater-raspberrypi/recipes-bsp/bootfiles/bcm2835-bootfiles.bbappend \
    /meta-updater-raspberrypi/recipes-bsp/u-boot-otascript/ \
"
```

## conf/local.conf.sample
```bitbake
MACHINE ??= '{{machine}}'
PACKAGE_CLASSES ?= "package_rpm"

# Set root password
INHERIT += "extrausers"
EXTRA_USERS_PARAMS = "usermod -P root root;"

# Comment this line to disable SSH server on target
EXTRA_IMAGE_FEATURES += "ssh-server-dropbear"

# Comment this line to disable SSH-ing into target as root 
EXTRA_IMAGE_FEATURES += "allow-empty-password"

USER_CLASSES ?= "buildstats image-mklibs image-prelink"
PATCHRESOLVE = "noop"
BB_DISKMON_DIRS ??= "\
    STOPTASKS,${TMPDIR},1G,100K \
    STOPTASKS,${DL_DIR},1G,100K \
    STOPTASKS,${SSTATE_DIR},1G,100K \
    STOPTASKS,/tmp,100M,100K \
    ABORT,${TMPDIR},100M,1K \
    ABORT,${DL_DIR},100M,1K \
    ABORT,${SSTATE_DIR},100M,1K \
    ABORT,/tmp,10M,1K"
PACKAGECONFIG_append_pn-qemu-native = " sdl"
PACKAGECONFIG_append_pn-nativesdk-qemu = " sdl"
CONF_VERSION = "1"
HOSTTOOLS_NONFATAL += " ostree ostree-push sshpass"
DL_DIR ?= "{{downloads}}"
ACCEPT_FSL_EULA = "1"

TMPDIR = "${TOPDIR}/tmp/${DISTRO}"

OSTREE_GPG_VERIFY ?= ""
OSTREEPUSH_SSH_USER = "root"
OSTREEPUSH_SSH_PASS = "root"

PREFERRED_RPROVIDER_virtual/network-configuration ?= "connman"

# Uncomment to add some extra packages to OS image
# IMAGE_INSTALL_append = " nano figlet pv"
```
